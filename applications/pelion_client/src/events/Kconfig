## applications/pelion_client/src/events/Kconfig
```kconfig
#
# Copyright (c) 2021 Nordic Semiconductor ASA
#
# SPDX-License-Identifier: LicenseRef-BSD-5-Clause-Nordic
#

menu "Event options"

comment "Initially logged events"

config PELION_INIT_LOG_NET_STATE_EVENT
	bool "Log net state event"
	depends on LOG
	default y

config PELION_INIT_LOG_PELION_STATE_EVENT
	bool "Log Pelion state event"
	depends on LOG
	default y

config PELION_INIT_LOG_PELION_CREATE_OBJECTS_EVENT
	bool "Log Pelion create objects event"
	depends on LOG
	default y

rsource "Kconfig.keep_alive_event"

endmenu
```

## applications/pelion_client/src/events/Kconfig.keep_alive_event
```kconfig
#
# Copyright (c) 2021 Nordic Semiconductor
#
# SPDX-License-Identifier: LicenseRef-Nordic-5-Clause
#

config PELION_CLIENT_KEEP_ALIVE_EVENT_ENABLE
	bool "Keep alive event"
	help
	  Enable keep alive event.

if PELION_CLIENT_KEEP_ALIVE_EVENT_ENABLE

config PELION_CLIENT_INIT_LOG_KEEP_ALIVE_EVENT
	bool "Log power manager keep alive event"
	help
	  Log the keep alive event.
endif
```

## applications/pelion_client/src/modules/Kconfig
```kconfig
#
# Copyright (c) 2021 Nordic Semiconductor ASA
#
# SPDX-License-Identifier: LicenseRef-BSD-5-Clause-Nordic
#

rsource "Kconfig.pelion"
rsource "Kconfig.net"
rsource "Kconfig.oma_objects"
rsource "Kconfig.led_state"
rsource "Kconfig.dfu"
rsource "Kconfig.power_manager"
```

## applications/pelion_client/src/modules/Kconfig.dfu
```kconfig
#
# Copyright (c) 2021 Nordic Semiconductor ASA
#
# SPDX-License-Identifier: LicenseRef-BSD-5-Clause-Nordic
#

menu "FW update"

module = PELION_CLIENT_DFU
module-str = DFU module
source "subsys/logging/Kconfig.template.log_config"

endmenu
```

## applications/pelion_client/src/modules/Kconfig.led_state
```kconfig
#
# Copyright (c) 2021 Nordic Semiconductor ASA
#
# SPDX-License-Identifier: LicenseRef-BSD-5-Clause-Nordic
#

menu "LED state"

module = PELION_CLIENT_LED_STATE
module-str = LED state module
source "subsys/logging/Kconfig.template.log_config"

endmenu
```

## applications/pelion_client/src/modules/Kconfig.net
```kconfig
#
# Copyright (c) 2021 Nordic Semiconductor ASA
#
# SPDX-License-Identifier: LicenseRef-BSD-5-Clause-Nordic
#

menu "Networking"

module = PELION_CLIENT_NET
module-str = Networking module
source "subsys/logging/Kconfig.template.log_config"

endmenu
```
